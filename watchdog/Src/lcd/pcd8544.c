#include "stm32f0xx_hal.h"
#include "../Src/lcd/pcd8544.h"

unsigned char PCD8544_Buffer[PCD8544_BUFFER_SIZE];
unsigned char PCD8544_UpdateXmin = 0, PCD8544_UpdateXmax = 0, PCD8544_UpdateYmin = 0, PCD8544_UpdateYmax = 0;
unsigned char PCD8544_x;
unsigned char PCD8544_y;


const uint8_t PCD8544_Font5x7 [97][PCD8544_CHAR5x7_WIDTH] = {
	{ 0x00, 0x00, 0x00, 0x00, 0x00 },   // sp
	{ 0x00, 0x00, 0x2f, 0x00, 0x00 },   // !
	{ 0x00, 0x07, 0x00, 0x07, 0x00 },   // "
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	{ 0x00, 0x7F, 0x3E, 0x1C, 0x08 }    // Play			128
};

const uint8_t PCD8544_Font3x5[106][3] = {
	{ 0x00, 0x00, 0x00 },   // sp - 32
	{ 0x00, 0x17, 0x00 },   // ! - 33
	{ 0x03, 0x00, 0x03 },   // " - 34
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	{ 0x1F, 0x1F, 0x1F },   // delete
};



unsigned char spi_soft(unsigned char dat)
{
	 GPIO_InitTypeDef GPIO_InitStruct;
	 GPIO_InitStruct.Pin = DI|SCK;
 	 GPIO_InitStruct.Mode = GPIO_MODE_OUTPUT_PP;
   GPIO_InitStruct.Pull = GPIO_NOPULL;
   GPIO_InitStruct.Speed = GPIO_SPEED_FREQ_HIGH;
 	 HAL_GPIO_Init(PCDPORT, &GPIO_InitStruct);
	unsigned char cnt = 8;
	while (cnt--) {
		if (dat & 0x80)  HAL_GPIO_WritePin(PCDPORT,DI,GPIO_PIN_SET);
		else HAL_GPIO_WritePin(PCDPORT,DI,GPIO_PIN_RESET);
		HAL_GPIO_WritePin(PCDPORT,SCK,GPIO_PIN_SET);
		dat <<= 1;
		HAL_GPIO_WritePin(PCDPORT,SCK,GPIO_PIN_RESET);
	}
	return dat;
}


void LcdWrite (unsigned char dc, unsigned data)
{
	if (dc==0) HAL_GPIO_WritePin(PCDPORT,DC,GPIO_PIN_RESET);
	if (dc==1) HAL_GPIO_WritePin(PCDPORT,DC,GPIO_PIN_SET);
	HAL_GPIO_WritePin(PCDPORT,CEE,GPIO_PIN_RESET);
	spi_soft(data);
	HAL_GPIO_WritePin(PCDPORT,CEE,GPIO_PIN_SET);
}

void LcdClear(void)
{
	for (int index = 0; index < LCD_X * LCD_Y / 8; index++)
	{
		LcdWrite(LCD_D, 0x00);
	}
	
}
void LcdClearBuffer(void){
	for (int i = 0; i<PCD8544_BUFFER_SIZE; i++){
		PCD8544_Buffer[i] = 0;
	}
}

void LcdInitialise(void)
{
  GPIO_InitTypeDef GPIO_InitStruct;
	GPIO_InitStruct.Pin = DC|RST|CEE;
 	GPIO_InitStruct.Mode = GPIO_MODE_OUTPUT_PP;
  GPIO_InitStruct.Pull = GPIO_NOPULL;
  GPIO_InitStruct.Speed = GPIO_SPEED_FREQ_HIGH;
 	HAL_GPIO_Init(PCDPORT, &GPIO_InitStruct);      
        
        
        
	HAL_GPIO_WritePin(PCDPORT,RST,GPIO_PIN_RESET);
	HAL_GPIO_WritePin(PCDPORT,RST,GPIO_PIN_SET);
	LcdWrite(LCD_C, 0x21 );  // LCD Extended Commands.
	LcdWrite(LCD_C, LCD_CONTRAST);  // Set LCD Vop (Contrast).
	LcdWrite(LCD_C, 0x014 );  // Set Temp coeffiCEEnt. //0x04
	LcdWrite(LCD_C, 0x14 );  // LCD bias mode 1:48. //0x13
	LcdWrite(LCD_C, 0x20 );  // LCD Basic Commands
	LcdWrite(LCD_C, 0x0C );  // LCD in normal mode.0x0D
}
void gotoXY(int x, int y)
{
  LcdWrite( 0, 0x80 | x);  // Column.
  LcdWrite( 0, 0x40 | y);  // Row.  

}

void LCDCharacter(char character)
{
   unsigned int i;
   LcdWrite(LCD_DATA, 0x00);                    //Blank vertical line padding
   for (i = 0; i < 5; i++)   LcdWrite(LCD_DATA, ASCII[character - 0x20][i]);
   LcdWrite(LCD_DATA, 0x00);                    //Blank vertical line padding
}

void LCDString(char *characters)                //Given a string of characters, one by one is passed to the LCD
{
   while (*characters)
    LCDCharacter(*characters++);
}

void PCD8544_DrawPixel(unsigned char x, unsigned char y, char pixel) {
	if (x >= PCD8544_WIDTH) {
		return;
	}
	if (y >= PCD8544_HEIGHT) {
		return;
	}

	if (pixel != PCD8544_Pixel_Clear) {
		PCD8544_Buffer[x + (y / 8) * PCD8544_WIDTH] |= 1 << (y % 8);
	} else {
		PCD8544_Buffer[x + (y / 8) * PCD8544_WIDTH] &= ~(1 << (y % 8));
	}
	PCD8544_UpdateArea(x, y, x, y);
}

void PCD8544_Invert(PCD8544_Invert_t invert) {
	if (invert != PCD8544_Invert_No) {
		LcdWrite(PCD8544_COMMAND, PCD8544_DISPLAYCONTROL | PCD8544_DISPLAYINVERTED);
	} else {
		LcdWrite(PCD8544_COMMAND, PCD8544_DISPLAYCONTROL | PCD8544_DISPLAYNORMAL);
	}
}

void PCD8544_Refresh(void) {
	unsigned char i, j;
	for (i = 0; i < 6; i++) {
		//Not in range yet
		if (PCD8544_UpdateYmin > ((i + 1) * 8)) {
			continue;
		}
		//Over range, stop
		if ((i * 8) > PCD8544_UpdateYmax) {
			break;
		}

		LcdWrite(PCD8544_COMMAND, PCD8544_SETYADDR | i);
		LcdWrite(PCD8544_COMMAND, PCD8544_SETXADDR | PCD8544_UpdateXmin);

		for (j = PCD8544_UpdateXmin; j <= PCD8544_UpdateXmax; j++) {
			LcdWrite(PCD8544_DATA, PCD8544_Buffer[(i * PCD8544_WIDTH) + j]);
		}
	}

	PCD8544_UpdateXmin = PCD8544_WIDTH - 1;
	PCD8544_UpdateXmax = 0;
	PCD8544_UpdateYmin = PCD8544_HEIGHT - 1;
	PCD8544_UpdateYmax = 0;
}

void PCD8544_UpdateArea(unsigned char xMin, unsigned char yMin, unsigned char xMax, unsigned char yMax) {
	if (xMin < PCD8544_UpdateXmin) {
		PCD8544_UpdateXmin = xMin;
	}
	if (xMax > PCD8544_UpdateXmax) {
		PCD8544_UpdateXmax = xMax;
	}
	if (yMin < PCD8544_UpdateYmin) {
		PCD8544_UpdateYmin = yMin;
	}
	if (yMax > PCD8544_UpdateYmax) {
		PCD8544_UpdateYmax = yMax;
	}
}

void drawLineH2(uint8_t x0, uint8_t x1, uint8_t y, uint8_t step)
{
  if(step>1) { if(((x0&1)==1 && (y&1)==0) || ((x0&1)==0 && (y&1)==1)) x0++; }
  if(x1>x0) for(uint8_t x=x0; x<=x1; x+=step) PCD8544_DrawPixel(x,y,PCD8544_Pixel_Set);
  else      for(uint8_t x=x1; x<=x0; x+=step) PCD8544_DrawPixel(x,y,PCD8544_Pixel_Set);
}

void drawLineV2(int x, int y0, int y1, int step)
{
  if(step>1) { if(((x&1)==1 && (y0&1)==0) || ((x&1)==0 && (y0&1)==1)) y0++; }
  if(y1>y0)for(int y=y0; y<=y1; y+=step) PCD8544_DrawPixel(x,y,PCD8544_Pixel_Set);
  else     for(int y=y1; y<=y0; y+=step) PCD8544_DrawPixel(x,y,PCD8544_Pixel_Set);
}


